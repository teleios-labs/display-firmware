## firmware/sdkconfig.defaults
```kconfig
# ESP32-P4 target
CONFIG_IDF_TARGET="esp32p4"

# Chip revision: Waveshare board has v1.3 silicon (pre-v3.0 "preliminary" chip)
# These are REQUIRED for ESP-IDF 5.5.x on pre-v3.0 chips
CONFIG_ESP32P4_SELECTS_REV_LESS_V3=y
CONFIG_ESP32P4_REV_MIN_100=y

# Flash (DIO mode — QIO crashes on this board during flash ID read)
CONFIG_ESPTOOLPY_FLASHMODE_DIO=y
CONFIG_ESPTOOLPY_FLASHSIZE_32MB=y

# PSRAM (required for display framebuffer)
CONFIG_SPIRAM=y
CONFIG_SPIRAM_SPEED_200M=y

# Cache (MIPI DSI DMA performance)
CONFIG_CACHE_L2_CACHE_256KB=y
CONFIG_CACHE_L2_CACHE_LINE_128B=y

# Required for MIPI DSI
CONFIG_IDF_EXPERIMENTAL_FEATURES=y

# Console output via USB Serial/JTAG (must explicitly unset UART default)
# CONFIG_ESP_CONSOLE_UART_DEFAULT is not set
CONFIG_ESP_CONSOLE_USB_SERIAL_JTAG=y

# Stack size (Slint needs headroom)
CONFIG_ESP_MAIN_TASK_STACK_SIZE=10240

# Performance
CONFIG_COMPILER_OPTIMIZATION_PERF=y
CONFIG_FREERTOS_HZ=1000
```

## sdkconfig.defaults
```kconfig
# Rust needs more stack than C defaults
CONFIG_ESP_MAIN_TASK_STACK_SIZE=8192
CONFIG_ESP_SYSTEM_EVENT_TASK_STACK_SIZE=4096
CONFIG_FREERTOS_IDLE_TASK_STACKSIZE=4096
CONFIG_PTHREAD_TASK_STACK_SIZE_DEFAULT=4096

# ESP32-S3 specific
CONFIG_ESP32S3_DEFAULT_CPU_FREQ_240=y
CONFIG_ESP32S3_DATA_CACHE_64KB=y
CONFIG_SPIRAM_FETCH_INSTRUCTIONS=y
CONFIG_SPIRAM_RODATA=y

# PSRAM
CONFIG_ESP32S3_SPIRAM_SUPPORT=y
CONFIG_SPIRAM_MODE_OCT=y
CONFIG_SPIRAM_SPEED_80M=y
```
